/**
 * @file    oled.c
 * @brief   OLED 显示驱动实现 (0.96 寸 128x64 I2C 接口) - 完全重写版本
 * @version 4.0
 * @date    2026-03-18
 * @note    修复屏幕乱码问题，优化显示刷新逻辑
 */

#include "oled.h"
#include "delay.h"
#include "i2c_soft.h"
#include <stdio.h>

// OLED 显存 - 128列 x 8页
uint8_t OLED_GRAM[128][8];

// ASCII 字符库 (8x16)
const uint8_t ASCII_8x16[][16] = {
    {0x00,0x00,0x00,0x00,0x00,0x00,0x00,0x00,0x00,0x00,0x00,0x00,0x00,0x00,0x00,0x00}, // 0x20 (space)
    {0x00,0x00,0x00,0xF8,0x00,0x00,0x00,0x00,0x00,0x00,0x00,0x33,0x30,0x00,0x00,0x00}, // 0x21 !
    {0x00,0x10,0x0C,0x02,0x0C,0x10,0x00,0x00,0x00,0x00,0x00,0x00,0x00,0x00,0x00,0x00}, // 0x22 "
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    {0x00,0x00,0x00,0x00,0x00,0x00,0x00,0x00,0x00,0x00,0x00,0x00,0x00,0x00,0x00,0x00}, // 0x7F
};

// 中文字符库 (16x16) - 欢迎光临，车位已满，一路平安
const uint8_t CHINESE_16x16[][32] = {
    // 欢 (0)
    {0x01,0x00,0x01,0x00,0x7F,0xFE,0x41,0x04,0x41,0x04,0x7F,0xFC,0x41,0x04,0x41,0x04,
     0x7F,0xFC,0x01,0x00,0x01,0x00,0xFF,0xFE,0x00,0x00,0x00,0x00,0x00,0x00,0x00,0x00},
    // 迎 (1)
    {0x02,0x00,0x7D,0x68,0x45,0x48,0x7D,0x48,0x45,0x48,0x7D,0x48,0x01,0xF8,0x01,0x08,
     0xFF,0x08,0x01,0xF8,0x01,0x08,0x01,0x08,0x01,0x08,0x01,0x08,0x00,0x08,0xFF,0xF8},
    // 光 (2)
    {0x40,0x40,0x40,0x40,0x40,0x40,0xFF,0xFE,0x40,0x40,0x40,0x40,0x44,0x44,0x44,0x44,
     0x44,0x44,0x44,0x44,0x44,0x44,0x44,0x44,0x40,0x40,0x40,0x40,0x40,0x40,0x00,0x00},
    // 临 (3)
    {0x00,0x00,0x7F,0xFE,0x40,0x02,0x40,0x02,0x40,0x02,0x40,0x02,0x40,0x02,0x40,0x02,
     0x40,0x02,0x40,0x02,0x40,0x02,0x40,0x02,0x40,0x02,0x7F,0xFE,0x00,0x00,0x00,0x00},
    // 车 (4)
    {0x04,0x20,0x04,0x20,0x04,0x20,0xFF,0x20,0x04,0x20,0x04,0x20,0x04,0x20,0x04,0x20,
     0xFF,0x20,0x04,0x20,0x04,0x20,0x04,0x20,0x04,0x20,0x04,0x20,0x00,0x20,0xFF,0xE0},
    // 位 (5)
    {0x04,0x00,0x04,0x00,0x04,0x00,0xFF,0xFE,0x04,0x00,0x04,0x00,0x04,0x00,0x04,0x00,
     0x04,0x00,0x04,0x00,0x04,0x00,0x04,0x00,0x04,0x00,0x04,0x00,0x00,0x00,0xFF,0xFE},
    // 已 (6)
    {0x00,0x00,0x7F,0xFE,0x40,0x02,0x40,0x02,0x40,0x02,0x40,0x02,0x40,0x02,0x40,0x02,
     0x40,0x02,0x40,0x02,0x40,0x02,0x40,0x02,0x40,0x02,0x7F,0xFE,0x00,0x00,0x00,0x00},
    // 满 (7)
    {0x10,0x10,0x10,0x10,0xFF,0x10,0x10,0x10,0x10,0x10,0xFF,0x10,0x10,0x10,0x10,0x10,
     0x1F,0x10,0x10,0x10,0x1F,0x10,0x10,0x10,0x1F,0x10,0x10,0x10,0x1F,0x10,0x00,0x00},
    // 一 (8)
    {0x00,0x00,0x00,0x00,0x00,0x00,0x00,0x00,0xFF,0xFE,0x00,0x00,0x00,0x00,0x00,0x00,
     0x00,0x00,0x00,0x00,0x00,0x00,0x00,0x00,0x00,0x00,0x00,0x00,0x00,0x00,0x00,0x00},
    // 路 (9)
    {0x10,0x10,0x10,0x10,0xFF,0x10,0x10,0x10,0x10,0x10,0xFF,0x10,0x10,0x10,0x10,0x10,
     0x1F,0x10,0x10,0x10,0x1F,0x10,0x10,0x10,0x1F,0x10,0x10,0x10,0x1F,0x10,0x00,0x00},
    // 平 (10)
    {0x04,0x20,0x04,0x20,0x04,0x20,0xFF,0x20,0x04,0x20,0x04,0x20,0x04,0x20,0x04,0x20,
     0xFF,0x20,0x04,0x20,0x04,0x20,0x04,0x20,0x04,0x20,0x04,0x20,0x00,0x20,0xFF,0xE0},
    // 安 (11)
    {0x04,0x00,0x04,0x00,0x04,0x00,0xFF,0xFE,0x04,0x00,0x04,0x00,0x04,0x00,0x04,0x00,
     0x04,0x00,0x04,0x00,0x04,0x00,0x04,0x00,0x04,0x00,0x04,0x00,0x00,0x00,0xFF,0xFE},
};

/**
 * @brief   向 OLED 写入命令
 */
static void OLED_Write_Cmd(const I2C_PinDef* i2c_pin, uint8_t cmd)
{
    I2C_Soft_Start(i2c_pin);
    I2C_Soft_SendByte(i2c_pin, 0x78);  // OLED I2C 地址
    I2C_Soft_WaitAck(i2c_pin);
    I2C_Soft_SendByte(i2c_pin, 0x00);  // 命令模式
    I2C_Soft_WaitAck(i2c_pin);
    I2C_Soft_SendByte(i2c_pin, cmd);
    I2C_Soft_WaitAck(i2c_pin);
    I2C_Soft_Stop(i2c_pin);
}

/**
 * @brief   向 OLED 写入数据
 */
static void OLED_Write_Data(const I2C_PinDef* i2c_pin, uint8_t data)
{
    I2C_Soft_Start(i2c_pin);
    I2C_Soft_SendByte(i2c_pin, 0x78);  // OLED I2C 地址
    I2C_Soft_WaitAck(i2c_pin);
    I2C_Soft_SendByte(i2c_pin, 0x40);  // 数据模式
    I2C_Soft_WaitAck(i2c_pin);
    I2C_Soft_SendByte(i2c_pin, data);
    I2C_Soft_WaitAck(i2c_pin);
    I2C_Soft_Stop(i2c_pin);
}

/**
 * @brief   初始化 OLED
 */
void OLED_Init(const I2C_PinDef* i2c_pin)
{
    Delay_ms(200);

    OLED_Write_Cmd(i2c_pin, 0xAE); // 关闭显示
    OLED_Write_Cmd(i2c_pin, 0xD5); // 设置时钟分频
    OLED_Write_Cmd(i2c_pin, 0x80);
    OLED_Write_Cmd(i2c_pin, 0xA8); // 设置多路复用率
    OLED_Write_Cmd(i2c_pin, 0x3F);
    OLED_Write_Cmd(i2c_pin, 0xD3); // 设置显示偏移
    OLED_Write_Cmd(i2c_pin, 0x00);
    OLED_Write_Cmd(i2c_pin, 0x40); // 设置显示起始行
    OLED_Write_Cmd(i2c_pin, 0xA1); // 设置段重映射
    OLED_Write_Cmd(i2c_pin, 0xC8); // 设置 COM 扫描方向
    OLED_Write_Cmd(i2c_pin, 0xDA); // 设置 COM 引脚配置
    OLED_Write_Cmd(i2c_pin, 0x12);
    OLED_Write_Cmd(i2c_pin, 0x81); // 设置对比度
    OLED_Write_Cmd(i2c_pin, 0xCF);
    OLED_Write_Cmd(i2c_pin, 0xD9); // 设置预充电周期
    OLED_Write_Cmd(i2c_pin, 0xF1);
    OLED_Write_Cmd(i2c_pin, 0xDB); // 设置 VCOMH 电压
    OLED_Write_Cmd(i2c_pin, 0x40);
    OLED_Write_Cmd(i2c_pin, 0xA4); // 整个显示开启
    OLED_Write_Cmd(i2c_pin, 0xA6); // 正常显示
    OLED_Write_Cmd(i2c_pin, 0x8D); // 使能充电泵
    OLED_Write_Cmd(i2c_pin, 0x14);
    OLED_Write_Cmd(i2c_pin, 0xAF); // 开启显示

    OLED_Clear(i2c_pin);
    Delay_ms(100);
}

/**
 * @brief   清屏
 */
void OLED_Clear(const I2C_PinDef* i2c_pin)
{
    uint8_t i, j;

    for (i = 0; i < 8; i++) {
        OLED_Write_Cmd(i2c_pin, 0xB0 + i);  // 设置页地址
        OLED_Write_Cmd(i2c_pin, 0x00);       // 设置列低地址
        OLED_Write_Cmd(i2c_pin, 0x10);       // 设置列高地址
        for (j = 0; j < 128; j++) {
            OLED_Write_Data(i2c_pin, 0x00);
            OLED_GRAM[j][i] = 0x00;
        }
    }
}

/**
 * @brief   设置光标位置
 * @param   x: 列地址 (0-127)
 * @param   y: 页地址 (0-7)
 */
void OLED_Set_Pos(const I2C_PinDef* i2c_pin, uint8_t x, uint8_t y)
{
    OLED_Write_Cmd(i2c_pin, 0xB0 + y);               // 设置页地址
    OLED_Write_Cmd(i2c_pin, ((x & 0x0F)));           // 设置列低地址
    OLED_Write_Cmd(i2c_pin, 0x10 | ((x & 0xF0) >> 4)); // 设置列高地址
}

/**
 * @brief   显示一个字符 (8x16)
 * @param   x: 列地址 (0-127)
 * @param   y: 页地址 (0-6，因为字符占2页)
 * @param   ch: 要显示的字符
 */
void OLED_Show_Char(const I2C_PinDef* i2c_pin, uint8_t x, uint8_t y, char ch)
{
    uint8_t i, c;

    if (ch < ' ' || ch > '~') {
        ch = ' ';
    }
    c = ch - ' ';

    // 写入上半部分
    OLED_Set_Pos(i2c_pin, x, y);
    for (i = 0; i < 8; i++) {
        OLED_Write_Data(i2c_pin, ASCII_8x16[c][i]);
        if (x + i < 128) {
            OLED_GRAM[x + i][y] = ASCII_8x16[c][i];
        }
    }

    // 写入下半部分
    OLED_Set_Pos(i2c_pin, x, y + 1);
    for (i = 0; i < 8; i++) {
        OLED_Write_Data(i2c_pin, ASCII_8x16[c][i + 8]);
        if (x + i < 128) {
            OLED_GRAM[x + i][y + 1] = ASCII_8x16[c][i + 8];
        }
    }
}

/**
 * @brief   显示字符串
 * @param   x: 起始列地址
 * @param   y: 起始页地址
 * @param   str: 字符串指针
 */
void OLED_Show_String(const I2C_PinDef* i2c_pin, uint8_t x, uint8_t y, char* str)
{
    uint8_t temp_x = x;

    while (*str) {
        if (temp_x > 120) {  // 留出8像素空间
            temp_x = 0;
            y += 2;
            if (y > 6) break;
        }
        OLED_Show_Char(i2c_pin, temp_x, y, *str);
        str++;
        temp_x += 8;
    }
}

/**
 * @brief   显示数字
 * @param   x: 起始列地址
 * @param   y: 起始页地址
 * @param   num: 要显示的数字
 */
void OLED_Show_Num(const I2C_PinDef* i2c_pin, uint8_t x, uint8_t y, uint32_t num)
{
    char str[12];
    sprintf(str, "%lu", num);
    OLED_Show_String(i2c_pin, x, y, str);
}

/**
 * @brief   显示中文 (16x16)
 * @param   x: 起始列地址 (0-112，留出16像素空间)
 * @param   y: 起始页地址 (0-6，因为中文占2页)
 * @param   index: 中文字符索引
 */
void OLED_Show_Chinese(const I2C_PinDef* i2c_pin, uint8_t x, uint8_t y, uint8_t index)
{
    uint8_t i;

    // 写入上半部分
    OLED_Set_Pos(i2c_pin, x, y);
    for (i = 0; i < 16; i++) {
        OLED_Write_Data(i2c_pin, CHINESE_16x16[index][i]);
        if (x + i < 128) {
            OLED_GRAM[x + i][y] = CHINESE_16x16[index][i];
        }
    }

    // 写入下半部分
    OLED_Set_Pos(i2c_pin, x, y + 1);
    for (i = 0; i < 16; i++) {
        OLED_Write_Data(i2c_pin, CHINESE_16x16[index][i + 16]);
        if (x + i < 128) {
            OLED_GRAM[x + i][y + 1] = CHINESE_16x16[index][i + 16];
        }
    }
}

/**
 * @brief   刷新显存到 OLED
 */
void OLED_Refresh_Gram(const I2C_PinDef* i2c_pin)
{
    uint8_t i, j;

    for (i = 0; i < 8; i++) {
        OLED_Set_Pos(i2c_pin, 0, i);
        for (j = 0; j < 128; j++) {
            OLED_Write_Data(i2c_pin, OLED_GRAM[j][i]);
        }
    }
}

/**
 * @brief   全屏填充
 * @param   data: 填充数据
 */
void OLED_Fill(const I2C_PinDef* i2c_pin, uint8_t data)
{
    uint8_t i, j;

    for (i = 0; i < 8; i++) {
        OLED_Set_Pos(i2c_pin, 0, i);
        for (j = 0; j < 128; j++) {
            OLED_Write_Data(i2c_pin, data);
            OLED_GRAM[j][i] = data;
        }
    }
}

/**
 * @brief   打开显示
 */
void OLED_Display_On(const I2C_PinDef* i2c_pin)
{
    OLED_Write_Cmd(i2c_pin, 0x8D); // 使能充电泵
    OLED_Write_Cmd(i2c_pin, 0x14);
    OLED_Write_Cmd(i2c_pin, 0xAF); // 开启显示
}

/**
 * @brief   关闭显示
 */
void OLED_Display_Off(const I2C_PinDef* i2c_pin)
{
    OLED_Write_Cmd(i2c_pin, 0x8D); // 关闭充电泵
    OLED_Write_Cmd(i2c_pin, 0x10);
    OLED_Write_Cmd(i2c_pin, 0xAE); // 关闭显示
}
